## CMakeLists.txt
```
# SPDX-License-Identifier: Apache-2.0

cmake_minimum_required(VERSION 3.20.0)
find_package(Zephyr REQUIRED HINTS $ENV{ZEPHYR_BASE})
project(pawr_gateway_9151)

target_sources(app PRIVATE
    src/main.c
    ../common/uart_frame.c
    ../common/sensor_log.c
    src/uart/uart_receiver.c
    src/uart/gui_uart_tx.c
    src/mqtt/mqtt_publisher.c
)
target_sources_ifdef(CONFIG_APP_MQTT_USE_TLS app PRIVATE src/mqtt/tls_provision.c)
target_include_directories(app PRIVATE ${CMAKE_CURRENT_SOURCE_DIR}/../common)
```

## Kconfig
```
# SPDX-License-Identifier: Apache-2.0

mainmenu "PAwR nRF9151 gateway"

menu "PAwR gateway broker settings"

config APP_MQTT_BROKER_HOSTNAME
    string "MQTT broker hostname or IP"
    default "test.mosquitto.org"
    help
      Left as a build-time default for convenience, but the intent is this
      stays swappable without touching source: same firmware image should
      work against a local Mosquitto instance or a TLS cloud broker (e.g.
      HiveMQ Cloud) by changing this + APP_MQTT_BROKER_PORT +
      APP_MQTT_USE_TLS at build time (or later, NVS-backed runtime config --
      not yet implemented, see gateway_9151/README.md).

config APP_MQTT_BROKER_PORT
    int "MQTT broker port"
    default 1883
    help
      1883 = plain MQTT (typical local Mosquitto default).
      8883 = MQTT over TLS (typical cloud broker / HiveMQ Cloud default).

config APP_MQTT_USE_TLS
    bool "Use TLS for the MQTT connection"
    default n
    select MQTT_LIB_TLS
    select MODEM_KEY_MGMT
    help
      Must be enabled for most cloud brokers (HiveMQ Cloud requires TLS on
      port 8883). Local Mosquitto is usually run without TLS during
      development. Selects MQTT_LIB_TLS, which is what actually gates the
      mqtt_client.transport.tls union member / MQTT_TRANSPORT_SECURE enum
      value this app's mqtt_publisher.c uses -- confirmed by a real build
      failure (undeclared MQTT_TRANSPORT_SECURE, no .tls member) before this
      select was added. Also selects MODEM_KEY_MGMT (depends on
      NRF_MODEM_LIB but doesn't get auto-enabled by anything else) for
      tls_provision.c's modem_key_mgmt_write()/_exists() calls -- confirmed
      by a real link failure (undefined reference to both) before this
      select was added. Deliberately does NOT select CONFIG_MBEDTLS: this
      project builds with CONFIG_NET_SOCKETS_OFFLOAD=y, so TLS is handled by
      the nRF9151 modem's own offloaded TLS stack (via sec_tag-based
      credentials, see tls_provision.c), not Zephyr's software mbedTLS --
      pulling in mbedTLS here would be for the wrong TLS implementation
      entirely.

config APP_MQTT_USERNAME
    string "MQTT username"
    default ""

config APP_MQTT_PASSWORD
    string "MQTT password"
    default ""

config APP_MQTT_CLIENT_ID
    string "MQTT client ID"
    default ""
    help
      Must be unique per physical gateway board -- two gateways connecting
      to the same broker with the same client ID makes the broker forcibly
      disconnect whichever one connected first, every time the other
      (re)connects (MQTT v3.1.1 duplicate-client-ID behavior). Left with no
      default (was a single fixed "pawr-gateway-9151" for every board until
      NOTES.md 2026-08-08's multi-gateway audit) so each board's secrets.conf
      must set its own, e.g. "pawr-gateway-9151-<N>" matching its central's
      CONFIG_APP_CENTRAL_ID. mqtt_publisher_init() panics at boot if this is
      still empty, rather than silently connecting under a colliding ID.

endmenu

menu "PAwR gateway UART framing"

config APP_UART_BAUDRATE
    int "UART baud rate for the link to the PAwR central board"
    default 115200

endmenu

config APP_DUMP_LOG_ON_BOOT
    bool "Dump the on-board flash sensor log as CSV over serial at boot"
    default n
    help
      One-shot retrieval mode: at boot, print every payload recorded in
      the on-board flash log (see ../common/sensor_log.h) as CSV over
      printk(), then continue normal operation as usual. Same mechanism
      as peripheral's CONFIG_APP_DUMP_ON_BOOT -- capture serial output
      right after boot to retrieve the CSV.

source "Kconfig.zephyr"
```

## prj.conf
```kconfig
# nRF9151 modem + LTE connection management.
#
# IMPORTANT (2026-08-03, see NOTES.md): this used to set
# CONFIG_NRF_MODEM_LIB_NET_IF=y, which auto-initializes the modem library as
# a network interface at system-init time -- i.e. BEFORE main() runs, and
# therefore before this app's own uart_receiver_init() call, no matter what
# order the source code in main() visually shows. Comparing against the
# known-working ../tempUART_READER reference project (same board, same
# UART1/arduino_serial wiring, confirmed receiving real UART data) found
# this was the one structurally different thing: that project does NOT set
# NRF_MODEM_LIB_NET_IF, and instead calls nrf_modem_lib_init() manually,
# explicitly, in main() -- AFTER uart_receiver_init(). Switched to match
# that proven-working init order exactly: manual nrf_modem_lib_init() +
# lte_lc_connect_async(), both called only after the UART receiver is
# already up. Whether NET_IF auto-init actually corrupts/resets UART1's
# state, or something else about its timing, hasn't been root-caused at the
# hardware/register level -- but matching the known-working sequence is the
# fix, not a diagnosis of the underlying mechanism.
CONFIG_NRF_MODEM_LIB=y
CONFIG_LTE_LINK_CONTROL=y

# Sockets are still offloaded to the modem (nrf_modem_lib provides this
# without needing CONFIG_NRF_MODEM_LIB_NET_IF's net_if wrapper -- confirmed
# by the reference project using plain lte_lc + CONFIG_NET_SOCKETS_OFFLOAD
# with no net_if/Connection Manager involved at all).
CONFIG_NETWORKING=y
CONFIG_NET_NATIVE=n
CONFIG_NET_SOCKETS=y
CONFIG_NET_SOCKETS_OFFLOAD=y
# Needed for the plain POSIX names (struct pollfd, POLLIN, struct addrinfo,
# getaddrinfo(), poll()) used in src/mqtt/mqtt_publisher.c -- without this,
# zephyr/net/socket.h only exposes the zsock_-prefixed forms. Confirmed by a
# real build failure the first time this was omitted (undeclared POLLIN,
# incomplete struct pollfd/addrinfo) -- see gateway_9151/README.md.
CONFIG_POSIX_API=y

# Generic Zephyr MQTT client -- broker-agnostic (works against Mosquitto or
# any cloud broker), unlike CONFIG_NRF_CLOUD_MQTT which is nRF-Cloud-specific.
# Confirmed against C:/ncs/v3.3.0/zephyr/samples/net/mqtt_publisher/prj.conf.
CONFIG_MQTT_LIB=y
CONFIG_MQTT_KEEPALIVE=120

# TLS is opt-in via APP_MQTT_USE_TLS (see Kconfig) -- most cloud brokers
# (HiveMQ Cloud) need it, plain local Mosquitto during dev usually doesn't.
# When APP_MQTT_USE_TLS=y, also set these (mirrors
# zephyr/samples/net/mqtt_publisher/overlay-tls.conf):
#   CONFIG_MQTT_LIB_TLS=y
#   CONFIG_NET_SOCKETS_SOCKOPT_TLS=y
#   CONFIG_MBEDTLS=y
#   CONFIG_MBEDTLS_BUILTIN=y
#   CONFIG_MBEDTLS_ENABLE_HEAP=y
#   CONFIG_MBEDTLS_HEAP_SIZE=30000
#   CONFIG_MBEDTLS_SSL_MAX_CONTENT_LEN=2048
# Left commented rather than unconditionally on: TLS pulls in mbedTLS's heap
# and cert provisioning (via the modem's credential storage, `nrf_cloud_credentials`-
# style AT%CMNG, or a plain cert on the socket) which we haven't wired up yet
# -- see gateway_9151/README.md "Not yet implemented".

# UART to the PAwR central board (framed binary, see src/uart/uart_frame.h).
CONFIG_SERIAL=y
CONFIG_UART_INTERRUPT_DRIVEN=y

# On-board flash log (Flash Circular Buffer) -- fallback record of every
# UART frame received from central, in case the MQTT/LTE hop is down for a
# while. Same FCB mechanism as central/peripheral (see common/sensor_log.c),
# BUT this board additionally needs CONFIG_SETTINGS=y + CONFIG_SETTINGS_FCB=y,
# which central/peripheral don't set explicitly (they get a storage partition
# as a side effect of their BLE stack enabling one of Settings' backends).
# Confirmed the hard way, two failures deep:
#   1. CONFIG_FCB+FLASH+FLASH_MAP alone built fine on this /ns (TF-M) target
#      (matching nrf/samples/cellular/modem_trace_flash's flag set) but
#      failed to LINK with "PM_storage_partition_ID undeclared" -- Partition
#      Manager only reserves a "storage_partition"/settings_storage region
#      "if SETTINGS_FCB || SETTINGS_NVS || ..." (see
#      nrf/subsys/partition_manager/Kconfig, pm.yml.settings), gated on
#      Zephyr's Settings subsystem backend choice, not on CONFIG_FCB/
#      FLASH_MAP directly. gateway_9151 has no BLE stack to pull one of
#      those in as a side effect the way central/peripheral do.
#   2. Adding CONFIG_SETTINGS_FCB=y alone still failed with the exact same
#      link error -- it silently no-op'd because SETTINGS_FCB is defined
#      inside Zephyr's "menuconfig SETTINGS" block (zephyr/subsys/settings/
#      Kconfig), so it's implicitly gated on SETTINGS=y too, not just its
#      explicit "depends on FCB". CONFIG_SETTINGS=y was still "not set" in
#      the generated .config until added explicitly below.
# Neither SETTINGS_FCB nor SETTINGS is ever actually exercised (no
# settings_subsys_init()/handler registered anywhere in this app) -- both
# enabled purely to trigger the PM partition reservation, not to use the
# Settings API.
CONFIG_FLASH=y
CONFIG_FLASH_MAP=y
CONFIG_FCB=y
CONFIG_SETTINGS=y
CONFIG_SETTINGS_FCB=y

CONFIG_LOG=y
CONFIG_PRINTK=y

CONFIG_HEAP_MEM_POOL_SIZE=19000
CONFIG_MAIN_STACK_SIZE=4096
CONFIG_SYSTEM_WORKQUEUE_STACK_SIZE=2048
CONFIG_FPU=y
```

## boards/nrf9151dk_nrf9151_ns.overlay
```dts
/*
 * Link to the PAwR central board (Seeed XIAO nRF52840): confirmed wiring is
 * XIAO uart1 (D8=P1.13 TX, D9=P1.14 RX, see
 * ../../central/boards/xiao_ble_nrf52840.overlay) <-> nRF9151 DK's
 * "arduino_serial" UART (P0.29 = TxD2, P0.28 = RxD2 on the Arduino header).
 *
 * uart1/arduino_serial is enabled with pins+baud already set at the
 * common-dtsi level (nrf9151dk_nrf9151_common.dtsi), BUT the "/ns"
 * (non-secure) board variant this app builds for explicitly disables it
 * again ("Disable UART1, because it is used by default in TF-M", see
 * nrf9151dk_nrf9151_ns.dts) -- confirmed by a real build failure
 * (DEVICE_DT_GET on a disabled node has no ordinal) before this override was
 * added. Re-enabling it here for the non-secure app is the standard,
 * supported pattern -- same one used by the in-tree
 * nrf/samples/peripheral/lpuart/boards/nrf9160dk_nrf9160_ns.overlay sample,
 * which does exactly this for the same uart1-vs-TF-M-default conflict on a
 * sibling nRF91 board. No TF-M/partition-manager changes needed beyond this
 * devicetree override -- it's a default-ownership setting, not a hardware
 * secure-lock.
 *
 * Wiring: 9151 DK TxD2 (P0.29) -> XIAO D9 (RX), 9151 DK RxD2 (P0.28) ->
 * XIAO D8 (TX), plus a shared GND between the two boards.
 */

&uart1 {
	status = "okay";
};

/ {
	aliases {
		pawr-uart = &arduino_serial;
	};
};
```

## src/main.c
```c
/*
 * Copyright (c) 2026
 *
 * SPDX-License-Identifier: Apache-2.0
 *
 * nRF9151 gateway: receives sensor_payload frames over UART from the PAwR
 * central board and republishes each as MQTT over LTE, plus (2026-08-12) a
 * UART fallback straight to a PC running gui/sensor_gui.py -- see
 * gateway_9151/README.md for what's wired up vs. still a stub.
 */

#include <zephyr/kernel.h>
#include <zephyr/sys/printk.h>
#include <modem/nrf_modem_lib.h>
#include <modem/lte_lc.h>

#include "pawr_protocol.h"
#include "sensor_log.h"
#include "uart/uart_receiver.h"
#include "uart/gui_uart_tx.h"
#include "mqtt/mqtt_publisher.h"

/* Init order (UART receiver, then modem lib, then LTE connect via
 * lte_lc_connect_async -- not Connection Manager) matches the confirmed-
 * working ../tempUART_READER reference project. See NOTES.md 2026-08-03/04:
 * the real bug that made the gateway's UART never receive anything was a
 * DK hardware setting (VCOM1 routing the Arduino header UART through the
 * board's Interface MCU instead of the SiP by default -- fixed via nRF
 * Connect for Desktop's Board Configurator app, not code), but this init
 * order is still worth keeping since it's the proven-working sequence.
 */
static K_SEM_DEFINE(lte_connected_sem, 0, 1);

static void lte_handler(const struct lte_lc_evt *const evt)
{
	switch (evt->type) {
	case LTE_LC_EVT_NW_REG_STATUS:
		if (evt->nw_reg_status == LTE_LC_NW_REG_REGISTERED_HOME ||
		    evt->nw_reg_status == LTE_LC_NW_REG_REGISTERED_ROAMING) {
			printk("[NET] LTE connected (%s)\n",
			       evt->nw_reg_status == LTE_LC_NW_REG_REGISTERED_HOME ? "home"
										     : "roaming");
			k_sem_give(&lte_connected_sem);
		}
		break;
	default:
		break;
	}
}

/* Queue of decoded frames between the UART ISR/callback context and the
 * main loop, which owns the (blocking) MQTT socket calls. A single-slot
 * message queue is enough at this sensor cadence (1 frame per node per 10s,
 * <=20 nodes -- worst case one frame every ~500ms, MQTT publish is much
 * faster than that), but if bursts start getting dropped, this is the first
 * thing to size up (see gateway_9151/README.md).
 */
K_MSGQ_DEFINE(frame_msgq, sizeof(struct sensor_payload), 8, 4);

static void on_uart_frame(const struct sensor_payload *payload)
{
	printk("[MAIN] UART frame received: node=%u seq=%u flags=0x%02x temp_cdeg=%d humidity_pct10=%u\n",
	       payload->node_id, payload->seq, payload->flags, payload->temp_cdeg,
	       payload->humidity_pct10);

	/* Fallback local record of every frame received from central, in case
	 * this gateway's own MQTT/LTE hop is down for a while -- same
	 * mechanism as peripheral's and central's on-board flash log, see
	 * common/sensor_log.h. Logged here (on receipt), not after a
	 * successful/failed publish, so the record is complete regardless of
	 * what happens downstream.
	 */
	sensor_log_append(payload);

	/* Second, independent fallback (2026-08-12): every frame also goes
	 * out the console UART toward a PC running gui/sensor_gui.py,
	 * unconditionally -- not gated on MQTT/LTE health. See
	 * uart/gui_uart_tx.h for why this is safe to share with printk's own
	 * output on the same wire.
	 */
	gui_uart_tx_send(payload);

	int err = k_msgq_put(&frame_msgq, payload, K_NO_WAIT);

	if (err) {
		printk("[MAIN] Frame queue full, dropping (node %u seq %u)\n",
		       payload->node_id, payload->seq);
	}
}

/* 2026-08-12: no SIM card / no LTE coverage must NOT stop this gateway from
 * running -- the UART fallback to gui/sensor_gui.py (gui_uart_tx_send(),
 * called from on_uart_frame() above) has to keep working with zero network
 * connectivity, since that's the whole point of it. Previously this
 * function blocked forever on LTE (K_FOREVER) and then outright exited
 * (return 0, so nothing after it -- including the frame-forwarding loop --
 * ever ran) if the initial MQTT connect failed. Both are now non-fatal:
 * LTE gets a generous but bounded wait, and MQTT is simply left
 * unavailable (mqtt_available = false) rather than treated as a startup
 * error, so the loop below is always reached.
 */
#define LTE_CONNECT_TIMEOUT K_SECONDS(30)

int main(void)
{
	printk("[MAIN] PAwR nRF9151 gateway starting\n");

	sensor_log_init();

	if (IS_ENABLED(CONFIG_APP_DUMP_LOG_ON_BOOT)) {
		sensor_log_dump_all();
	}

	int err = uart_receiver_init(on_uart_frame);

	if (err) {
		printk("[MAIN] uart_receiver_init failed: %d\n", err);
		return 0;
	}

	err = gui_uart_tx_init();
	if (err) {
		printk("[MAIN] gui_uart_tx_init failed: %d -- fallback UART forwarding disabled, everything else unaffected\n",
		       err);
	}

	bool mqtt_available = false;

	err = nrf_modem_lib_init();
	if (err) {
		printk("[MAIN] nrf_modem_lib_init failed: %d -- continuing without LTE/MQTT, UART fallback still active\n",
		       err);
	} else {
		printk("[NET] Connecting to LTE...\n");
		err = lte_lc_connect_async(lte_handler);
		if (err) {
			printk("[MAIN] lte_lc_connect_async failed: %d -- continuing without LTE/MQTT, UART fallback still active\n",
			       err);
		} else if (k_sem_take(&lte_connected_sem, LTE_CONNECT_TIMEOUT)) {
			printk("[NET] LTE connect timed out -- continuing without LTE/MQTT, UART fallback still active\n");
		} else {
			err = mqtt_publisher_init();
			if (err) {
				printk("[MAIN] mqtt_publisher_init failed: %d -- continuing without MQTT, UART fallback still active\n",
				       err);
			} else {
				mqtt_available = true;
			}
		}
	}

	struct sensor_payload payload;

	while (1) {
		if (k_msgq_get(&frame_msgq, &payload, K_MSEC(500)) == 0 && mqtt_available) {
			err = mqtt_publisher_send(&payload);
			if (err) {
				printk("[MAIN] mqtt_publisher_send failed: %d (node %u seq %u)\n",
				       err, payload.node_id, payload.seq);
			}
		}

		if (mqtt_available) {
			mqtt_publisher_process();
		}
	}

	return 0;
}
```
